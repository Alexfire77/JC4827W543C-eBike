## sdkconfig.defaults
```kconfig
# Чип ESP32-S3
CONFIG_IDF_TARGET="esp32s3"

# Flash: 4MB QIO 80MHz
CONFIG_ESPTOOLPY_FLASHSIZE_4MB=y
CONFIG_ESPTOOLPY_FLASHMODE_QIO=y
CONFIG_ESPTOOLPY_FLASHFREQ_80M=y

# PSRAM (OPI, 80MHz)
CONFIG_SPIRAM=y
CONFIG_SPIRAM_MODE_OCT=y
CONFIG_SPIRAM_SPEED_80M=y
CONFIG_SPIRAM_BOOT_INIT=y
CONFIG_SPIRAM_IGNORE_NOTFOUND=y

# Консоль через UART (не USB CDC)
CONFIG_ESP_CONSOLE_USB_CDC=n
CONFIG_ESP_CONSOLE_UART_DEFAULT=y

# FreeRTOS: 1000 Hz tick
CONFIG_FREERTOS_HZ=1000

# Размер стека главной задачи
CONFIG_ESP_MAIN_TASK_STACK_SIZE=8192

# LVGL: RGB565
CONFIG_LV_COLOR_DEPTH_16=y
```
